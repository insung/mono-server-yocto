## build/conf/bblayers.conf
```bitbake
# POKY_BBLAYERS_CONF_VERSION is increased each time build/conf/bblayers.conf
# changes incompatibly
POKY_BBLAYERS_CONF_VERSION = "2"

BBPATH = "${TOPDIR}"
BBFILES ?= ""

YOCTOROOT = "${@os.path.abspath(os.path.join("${TOPDIR}", os.pardir))}"

BBLAYERS ?= " \
  ${YOCTOROOT}/meta \
  ${YOCTOROOT}/meta-poky \
  ${YOCTOROOT}/meta-yocto-bsp \
  ${YOCTOROOT}/meta-oe \
  ${YOCTOROOT}/meta-mono \
  "
  
#### add layer meta-mono ####

# We have a conf and classes directory, add to BBPATH
BBPATH .= ":${LAYERDIR}"

# We have a recipes directory, add to BBFILES
BBFILES += "${LAYERDIR}/*/*/*.bb \
                         ${LAYERDIR}/*/*/*.bbappend"

BBFILE_COLLECTIONS += "mono"
BBFILE_PATTERN_mono := "^${LAYERDIR}/"
BBFILE_PRIORITY_mono = "1"
```
